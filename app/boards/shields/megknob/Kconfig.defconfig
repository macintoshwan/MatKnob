## app/boards/shields/megknob/Kconfig.defconfig
```kconfig
# Copyright (c) 2026 The ZMK Contributors
# SPDX-License-Identifier: MIT

if SHIELD_MEGKNOB

config ZMK_KEYBOARD_NAME
    default "MegKnob"

config ZMK_BLE
    default y

config ZMK_USB
    default y

if ZMK_DISPLAY

choice ZMK_DISPLAY_STATUS_SCREEN
    default ZMK_DISPLAY_STATUS_SCREEN_CUSTOM
endchoice

config I2C
    default y

config SSD1306
    default y

endif # ZMK_DISPLAY

if LVGL

config LV_Z_VDB_SIZE
    default 64

config LV_DPI_DEF
    default 148

config LV_Z_BITS_PER_PIXEL
    default 1

config LV_FONT_MONTSERRAT_12
    default y

choice LV_COLOR_DEPTH
    default LV_COLOR_DEPTH_1
endchoice

endif # LVGL

if ZMK_BATTERY_REPORTING

choice ZMK_BATTERY_REPORTING_FETCH_MODE
    # Both nice!nano v1's voltage divider and v2's nRF VDDH sensor expose
    # battery voltage, not a fuel-gauge state-of-charge channel.
    default ZMK_BATTERY_REPORTING_FETCH_MODE_LITHIUM_VOLTAGE
endchoice

endif # ZMK_BATTERY_REPORTING

endif
```

## app/boards/shields/megknob/Kconfig.shield
```kconfig
# Copyright (c) 2026 The ZMK Contributors
# SPDX-License-Identifier: MIT

config SHIELD_MEGKNOB
    def_bool $(shields_list_contains,megknob)
```

## app/module/dts/bindings/kscan/zmk,kscan-adc-mux.yaml
```yaml
# Copyright (c) 2026 The ZMK Contributors
# SPDX-License-Identifier: MIT

description: ADC keyboard mux controller

compatible: "zmk,kscan-adc-mux"

include: kscan.yaml

properties:
  address-gpios:
    type: phandle-array
    required: true
    description: 4051 address pins, ordered from least significant bit to most significant bit.

  io-channels:
    type: phandle-array
    required: true
    description: ADC inputs connected to the mux common pins.

  polling-interval-ms:
    type: int
    default: 5

  settle-time-us:
    type: int
    default: 20

  press-threshold-mv:
    type: int
    required: true

  release-threshold-mv:
    type: int
    required: true

  press-is-greater:
    type: boolean
    description: Treat voltages greater than the press threshold as pressed.

  debounce-press-ms:
    type: int
    default: 5
    description: >
      Debounce time for key press in milliseconds. Because analog Hall
      readings can hover right at the press/release threshold (bounce/noise
      near the flip point), each channel must report the same instantaneous
      state for this many milliseconds of consecutive scans before the press
      is latched and forwarded to the callback.

  debounce-release-ms:
    type: int
    default: 5
    description: >
      Debounce time for key release in milliseconds, using the same
      consecutive-scan confirmation algorithm as debounce-press-ms.
```

## app/module/lib/hall_telemetry/Kconfig
```kconfig
# Copyright (c) 2026 The ZMK Contributors
# SPDX-License-Identifier: MIT

DT_CHOSEN_ZMK_HALL_TELEMETRY_UART := zmk,hall-telemetry-uart

menuconfig HALL_TELEMETRY
    bool "MegKnob Hall voltage telemetry over USB CDC ACM"
    depends on $(dt_chosen_enabled,$(DT_CHOSEN_ZMK_HALL_TELEMETRY_UART))
    select SERIAL
    select USB_DEVICE_STACK
    select USB_CDC_ACM
    select UART_INTERRUPT_DRIVEN
    help
      Stream 24-channel Hall/ADC voltage samples out over a dedicated USB CDC
      ACM virtual serial port, using the MegKnob protocol v3 wire format, so
      a browser-based configurator or the existing tools/megknob_hall_viewer.py
      can display
      real-time waveforms.

      This is intentionally decoupled from HID/BLE: producers (e.g. the
      kscan_adc_mux driver) only ever push samples into a bounded queue with
      K_NO_WAIT and never block; all USB I/O happens on a dedicated,
      K_LOWEST_APPLICATION_THREAD_PRIO thread so a slow, absent, or
      disconnected USB host cannot stall key scanning, HID reporting, or the
      BLE stack. When the queue is full the oldest pending frame is dropped
      instead of blocking the producer.

if HALL_TELEMETRY

config HALL_TELEMETRY_QUEUE_DEPTH
    int "Pending telemetry frame queue depth"
    default 4
    range 2 32
    help
      Number of complete 62-byte frames that can be buffered waiting for USB
      to drain. Kept small on purpose: telemetry is best-effort and should
      never accumulate meaningful latency relative to the live signal.

config HALL_TELEMETRY_PERF_FRAME_INTERVAL
    int "Scans between performance frames"
    default 256
    range 16 4096
    help
      Emit one type=3 performance frame (scan/address/adc/process timing)
      every N submitted data frames, matching the existing protocol v3
      wire format and tools/megknob_hall_viewer.py's expectations.

endif # HALL_TELEMETRY
```

## app/src/host_cmd/Kconfig
```kconfig
# Copyright (c) 2026 The ZMK Contributors
# SPDX-License-Identifier: MIT

menu "Host Command"

DT_CHOSEN_ZMK_HOST_CMD_UART := zmk,host-cmd-uart

menuconfig ZMK_HOST_CMD
    bool "Host command injection"
    depends on (!ZMK_SPLIT || ZMK_SPLIT_ROLE_CENTRAL)
    depends on $(dt_chosen_enabled,$(DT_CHOSEN_ZMK_HOST_CMD_UART))
    select SERIAL
    select USB_DEVICE_STACK
    select USB_CDC_ACM
    select UART_INTERRUPT_DRIVEN
    select UART_LINE_CTRL
    help
      Enable a text command channel over UART/USB CDC ACM that can inject
      key press/release events into ZMK.

if ZMK_HOST_CMD

config ZMK_HOST_CMD_LINE_MAX_LEN
    int "Max command line length"
    default 64
    range 16 256

config ZMK_HOST_CMD_QUEUE_DEPTH
    int "Pending command queue depth"
    default 8
    range 1 32

config ZMK_HOST_CMD_CLICK_DELAY_MS
    int "Mouse click release delay (ms)"
    default 8
    range 0 100

config ZMK_HOST_CMD_FAILSAFE_TIMEOUT_MS
    int "Failsafe timeout without valid commands (ms)"
    default 500
    range 50 5000

endif

endmenu
```
