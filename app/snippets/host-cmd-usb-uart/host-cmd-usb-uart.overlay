/*
 * Copyright (c) 2026 The ZMK Contributors
 *
 * SPDX-License-Identifier: MIT
 */

/ {
    chosen {
        zmk,host-cmd-uart = &snippet_host_cmd_usb_uart;
    };
};

&zephyr_udc0 {
    snippet_host_cmd_usb_uart: snippet_host_cmd_usb_uart {
        compatible = "zephyr,cdc-acm-uart";
    };
};